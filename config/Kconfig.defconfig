## config/Kconfig.defconfig
```kconfig
config ZMK_KEYBOARD_NAME
	default "Azelus MK4"
    
# Bluetooth settings
CONFIG_BT_GATT_ENFORCE_SUBSCRIPTION=y
CONFIG_ZMK_BLE_PASSKEY_ENTRY=y
```

## config/boards/shields/Kconfig.shield
```kconfig
# Copyright (c) 2020 Pete Johanson
# SPDX-License-Identifier: MIT

config SHIELD_AZELUS_MK4
    def_bool $(shields_list_contains,azelus_mk4)
```

## config/boards/shields/azelus_mk4/Kconfig.defconfig
```kconfig
if SHIELD_AZELUS_MK4

config ZMK_KEYBOARD_NAME
	default "Azelus MK4"
	
endif
    
# Bluetooth settings
CONFIG_BT_GATT_ENFORCE_SUBSCRIPTION=y
CONFIG_ZMK_BLE_PASSKEY_ENTRY=y

CONFIG_ZMK_USB=y
CONFIG_USB_DEVICE_VID=0xC0DE
CONFIG_USB_DEVICE_PID=0xBA5E
CONFIG_USB_DEVICE_MANUFACTURER=Azel4231(+ZMK)
```

## shield/Kconfig.defconfig
```kconfig
config ZMK_KEYBOARD_NAME="Azelus MK4"
    
# Bluetooth settings
CONFIG_BT_GATT_ENFORCE_SUBSCRIPTION=y
CONFIG_ZMK_BLE_PASSKEY_ENTRY=y

endif
```
